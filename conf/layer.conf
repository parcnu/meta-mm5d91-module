## conf/layer.conf
```bitbake
# We have a conf and classes directory, add to BBPATH
BBPATH .= ":${LAYERDIR}"

# We have recipes-* directories, add to BBFILES
BBFILES += "${LAYERDIR}/recipes-*/*/*.bb \
            ${LAYERDIR}/recipes-*/*/*.bbappend"

BBFILE_COLLECTIONS += "meta-mm5d91-module"
BBFILE_PATTERN_meta-mm5d91-module = "^${LAYERDIR}/"
BBFILE_PRIORITY_meta-mm5d91-module = "6"

LAYERDEPENDS_meta-mm5d91-module = "core"
LAYERSERIES_COMPAT_meta-mm5d91-module = "scarthgap styhead kirkstone"
```
